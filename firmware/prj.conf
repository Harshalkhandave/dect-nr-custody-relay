## CMakeLists.txt
```
#
# Copyright (c) 2026 Conexio Technologies, Inc
#
# SPDX-License-Identifier: Apache-2.0
#

cmake_minimum_required(VERSION 3.20.0)

find_package(Zephyr REQUIRED HINTS $ENV{ZEPHYR_BASE})
project(nrplus_exp_store)

target_sources(app PRIVATE
  src/main.c
  src/sf_codec.c
  src/sf_dedup.c
  src/sf_store.c
  src/sf_link.c
  src/sf_node.c
  src/sf_port.c
  src/sf_shell.c
  src/sf_persist.c
)

target_include_directories(app PRIVATE src)

# Git revision of the firmware sources, logged at every boot (BOOT_INFO). "-dirty" means uncommitted
# changes under firmware/. It is read when CMake configures, so use a fresh build directory after a commit.
execute_process(COMMAND git -C ${CMAKE_CURRENT_SOURCE_DIR} rev-parse --short=8 HEAD
		OUTPUT_VARIABLE SF_GIT_REV OUTPUT_STRIP_TRAILING_WHITESPACE ERROR_QUIET)
execute_process(COMMAND git -C ${CMAKE_CURRENT_SOURCE_DIR} status --porcelain -- .
		OUTPUT_VARIABLE SF_GIT_DIRTY OUTPUT_STRIP_TRAILING_WHITESPACE ERROR_QUIET)
if(NOT SF_GIT_REV)
  set(SF_GIT_REV "unknown")
elseif(SF_GIT_DIRTY)
  set(SF_GIT_REV "${SF_GIT_REV}-dirty")
endif()
target_compile_definitions(app PRIVATE SF_GIT_REV=\"${SF_GIT_REV}\")
```

## Kconfig
```
#
# Copyright (c) 2026 Conexio Technologies, Inc
#
# SPDX-License-Identifier: Apache-2.0
#

menu "DECT NR+ store-and-forward"

config CARRIER
	int "Carrier number"
	default 0
	help
	  Required. Set this in overlay-us.conf or overlay-eu.conf.
	  Band index 1 is used only for carriers 525..551.
	  This is build-time because it is a regulatory choice, not a lab knob.

config NETWORK_ID
	int "DECT network id"
	range 1 4294967295
	default 91
	help
	  Build-time. Both the PHY header short id and the modem network id
	  use this value. Do not change it on one board only.

config TX_POWER
	int "Default TX power index (0..13)"
	range 0 13
	default 10
	help
	  Starting value for exp sett power. Not dBm. Overlays may override it.
	  Runtime changes apply to the next transmission.

config MCS
	int "Default MCS"
	range 0 7
	default 0
	help
	  Starting value for exp sett mcs. The measurements used MCS 0.

config SF_PHY_MTU
	int "Maximum PHY payload (bytes)"
	range 32 249
	default 249
	help
	  Total on-air application PDU, header included. 249 is the largest size
	  that was put on the air at MCS 0. The 18-byte protocol header is inside
	  this budget, so the largest application payload is MTU - 18.

config SF_RX_FILTER_ID
	int "PHY RX filter receiver identity"
	range 0 65535
	default 0
	help
	  0 accepts every receiver identity (broadcast filter).

config SF_HARQ_RX_PROCESSES
	int "Modem HARQ RX process count"
	range 1 8
	default 4

config SF_HARQ_RX_EXPIRY_US
	int "Modem HARQ RX expiry (microseconds)"
	default 5000000

config SF_DEVICE_ID_OVERRIDE
	bool "Override the hardware device id"
	default n

config SF_DEVICE_ID
	int "Device id override"
	depends on SF_DEVICE_ID_OVERRIDE
	range 1 65534
	default 1
	help
	  Normally the id is the first two bytes from hwinfo.
	  Override only for a bench that must use fixed ids.

choice SF_DEFAULT_ROLE
	prompt "Role after boot (before a saved profile)"
	default SF_ROLE_SOURCE

config SF_ROLE_SOURCE
	bool "source"

config SF_ROLE_RELAY
	bool "relay"

config SF_ROLE_SINK
	bool "sink"

endchoice

config SF_DEST_ID
	int "Default destination id"
	range 0 65535
	default 0
	help
	  0 means unset. A source will not start until exp sett dest or a profile.

config SF_PAYLOAD_LEN
	int "Default application payload (bytes)"
	range 1 231
	default 64
	help
	  This is the application payload, not the on-air frame.
	  The frame is this value plus the 18-byte header.
	  It must fit CONFIG_SF_SMALL_PAYLOAD, or the large pool when that is enabled.

config SF_INTERVAL_MS
	int "Default source period (ms)"
	range 0 600000
	default 1000
	help
	  0 turns the periodic generator off. Use exp alarm, or set a period.

config SF_COUNT
	int "Default packet count (0 = until stop)"
	range 0 4294967295
	default 0

config SF_HELLO_MS
	int "Default HELLO period (ms, 0 = off)"
	range 0 600000
	default 2000

config SF_TTL
	int "Default hop limit"
	range 1 16
	default 5

config SF_DIRECT_FALLBACK
	bool "If no route entry, send straight to the destination id"
	default y
	help
	  Turn off when the source must be forced through exp route.
	  Runtime: exp sett direct on|off. A saved profile overrides this default.

config SF_ASSUME_UP
	bool "Treat a new next hop as UP without probing"
	default n
	help
	  Off matches the protocol rule that a link becomes UP only after N probes.
	  Turn on for a bench that should move data immediately.
	  Runtime: exp sett assume_up on|off.

config SF_DEDUPE
	bool "Drop duplicate deliveries"
	default y
	help
	  Off delivers every copy. Leave it on unless you are deliberately
	  testing the duplicate path. Runtime: exp sett dedup on|off.

config SF_CUSTODY
	bool "Hop-by-hop custody (ACK, retry, link-state gating)"
	default y
	help
	  Off selects open-loop mode: each stored frame is sent once, no ACK is
	  waited for or sent, the slot is released at once, and link state does
	  not gate sending (no PROBE frames). All nodes in a run must use the
	  same setting. Runtime: exp sett custody on|off, only while stopped.

config SF_LIVENESS_ANY_FRAME
	bool "Any frame from a neighbour counts as proof of life"
	default y
	help
	  On: every frame heard from a neighbour refreshes its liveness (HELLO, ACK,
	  PROBE, DATA, also overheard ones). A node sends a HELLO only if it has
	  transmitted nothing for a HELLO interval (and once at start), and links
	  are reset on every start. Off: only HELLO refreshes liveness, HELLOs are
	  periodic, and links survive a stop and start.

config SF_GEN_CLASS_ALARM
	bool "Periodic generator sends alarm instead of telemetry"
	default n

choice SF_DEFAULT_POLICY
	prompt "Telemetry overflow policy"
	default SF_POLICY_REJECT

config SF_POLICY_REJECT
	bool "reject (ACK QUEUE_FULL, sender keeps the packet)"

config SF_POLICY_DROP_OLDEST
	bool "drop oldest telemetry already in this store"

endchoice

config SF_HELLO_TX_ON
	bool "Send HELLO even from a source"
	default n
	help
	  When off, HELLO follows the role: relay and sink send it, source does not.
	  Runtime exp sett hello_tx auto|on|off replaces this.

menu "Store capacity"

config SF_SMALL_SLOTS
	int "Small-pool slots"
	range 1 512
	default 320
	help
	  Telemetry capacity is (slots - alarm reserved). At 1 packet/s,
	  320 slots with 32 reserved is about 288 seconds of backlog.
	  Raise this only after a ram_report. Each slot costs the payload
	  size plus about 32 bytes of metadata.

config SF_SMALL_PAYLOAD
	int "Small-pool payload capacity (bytes)"
	range 1 231
	default 64

config SF_SMALL_ALARM_SLOTS
	int "Small slots reserved for alarm"
	range 0 512
	default 32
	help
	  Telemetry cannot use these. Alarm can use any free slot.
	  Must be <= CONFIG_SF_SMALL_SLOTS.

config SF_LARGE_SLOTS
	int "Large-pool slots"
	range 0 96
	default 0
	help
	  Leave at 0 until a test sends payloads above the small-pool size.
	  Each slot is CONFIG_SF_LARGE_PAYLOAD bytes plus metadata.

config SF_LARGE_PAYLOAD
	int "Large-pool payload capacity (bytes)"
	range 1 231
	default 231

config SF_LARGE_ALARM_SLOTS
	int "Large slots reserved for alarm"
	range 0 96
	default 0

endmenu

menu "ARQ, listen, and link"

config SF_ACK_TIMEOUT_MS
	int "ACK wait after TX (ms)"
	range 1 5000
	default 200
	help
	  Provisional. A relay that is itself waiting for a downstream ACK
	  can delay the upstream ACK by about this long. Measure RTT on a
	  clean 1-hop run, then lower it with exp sett ack_timeout.
	  Do not start from the spec's 40 ms until that capture exists.

config SF_MAX_ATTEMPTS
	int "Transmissions before the link is declared DOWN"
	range 1 8
	default 4
	help
	  Counts the first send. 4 means one send plus three retries.
	  The packet stays in the store.

config SF_BACKOFF_MIN_MS
	int "Minimum retry backoff (ms)"
	range 0 1000
	default 10

config SF_BACKOFF_MAX_MS
	int "Maximum of the first retry window (ms)"
	range 0 5000
	default 20

config SF_BACKOFF_CAP_MS
	int "Backoff window cap (ms)"
	range 0 10000
	default 80

config SF_NACK_HOLDOFF_MS
	int "Holdoff after QUEUE_FULL or NO_ROUTE (ms)"
	range 0 60000
	default 1000
	help
	  Doubled when the ACK reports queue_free = 0.

config SF_INTER_TX_LISTEN_MS
	int "Listen gap after a completed exchange (ms)"
	range 0 1000
	default 20

config SF_RX_SLICE_MS
	int "Idle receive slice (ms)"
	range 1 500
	default 15
	help
	  An ACK is sent at the end of the slice that received the frame,
	  so this is the worst-case extra ACK delay while idle.
	  Stop also waits out the current slice.

config SF_HELLO_DEAD_MS
	int "DOWN if a neighbour that has HELLO'd goes silent (ms, 0 = off)"
	range 0 600000
	default 7000
	help
	  Applied only after at least one HELLO from that next hop.
	  A peer with HELLO disabled does not kill the link.

config SF_T_PROBE_MS
	int "Probe timer while DOWN (ms)"
	range 0 60000
	default 3000

config SF_PROBE_FAST_MS
	int "Gap between successful probes (ms)"
	range 1 5000
	default 200

config SF_N_UP
	int "Consecutive probe replies required before UP"
	range 1 8
	default 3

config SF_HOLDDOWN_MIN_MS
	int "First hold-down after UP to DOWN (ms)"
	range 0 60000
	default 5000

config SF_HOLDDOWN_MAX_MS
	int "Hold-down cap (ms)"
	range 0 120000
	default 60000

config SF_HOLDDOWN_RESET_MS
	int "Stable UP time that clears the hold-down streak (ms)"
	range 0 600000
	default 60000

config SF_POLL_ALWAYS
	def_bool y
	select POLL

config SF_CTRL_SUBSLOTS
	int "Default PHY length of HELLO, ACK and PROBE frames (subslots: 4, 8 or 16)"
	range 4 16
	default 8
	help
	  Runtime: exp sett ctrl_subslots 4|8|16. DATA frames use the length rule
	  in sf_phy.h.

config SF_RSSI_LEVEL
	int "Default RX RSSI level passed to the modem (dBm)"
	range -127 0
	default -60
	help
	  Runtime: exp sett rssi_level <dBm>.

config SF_HOLD_CANCEL_MS
	int "Silence after which a returning neighbour ends the hold-down (ms, 0 = off)"
	range 0 60000
	default 3000
	help
	  A DOWN link whose neighbour was silent for at least this long and is then heard
	  again goes to PROBING at once instead of waiting for the hold-down. Probing still
	  needs N_UP replies. A neighbour that stays audible keeps the hold-down. Must be
	  above the longest normal gap between frames from one node (a HELLO is every
	  1.8 to 2.2 s). Runtime: exp sett hold_cancel <ms>; 0 turns it off.

config SF_TELEMETRY_TTL_MS
	int "Drop stored telemetry older than this (ms, 0 = never)"
	range 0 86400000
	default 600000

config SF_STREAM_IDLE_MS
	int "Forget a dedup stream after this idle time (ms, 0 = never)"
	range 0 86400000
	default 1800000

config SF_ALARM_RATE
	int "Alarm token rate (per second)"
	range 0 100
	default 5

config SF_ALARM_BURST
	int "Alarm token burst"
	range 1 100
	default 10

config SF_ROUTE_MAX
	int "Route table entries"
	range 1 8
	default 4

config SF_LINK_MAX
	int "Next-hop link entries"
	range 1 8
	default 4

config SF_MAX_STREAMS
	int "Dedup streams"
	range 1 16
	default 16

config SF_NEIGH_MAX
	int "Neighbour table entries"
	range 1 8
	default 8

config SF_ACK_QUEUE
	int "ACKs that can be waiting to transmit"
	range 1 8
	default 4

config SF_RX_QUEUE
	int "Receive messages queued from the modem callback"
	range 2 16
	default 8

endmenu

config SF_LOG_RX_CTRL
	bool "Log an RX line for every ACK, HELLO and PROBE"
	default n
	help
	  Off logs RX lines for DATA only. ACKs already appear as ACK_RX and
	  ACK_TX and HELLO as TX, so the RX lines for control frames only add
	  about 20% to the log volume, which matters at 115200 baud when the
	  relay drains a backlog. On logs every control frame.

config SF_RX_EVENT_DRIVEN
	bool "Event-driven idle listening (one long receive instead of 15 ms slices)"
	default y
	select POLL
	help
	  On: an idle node listens until its next deadline (generate, HELLO, link
	  timers), at most SF_RX_MAX_MS, and the receive is ended early only when a
	  frame arrives, a shell command needs the node, or the deadline is due (never
	  in the middle of an arriving frame, and never during an ACK wait except by
	  an ACK). Off: repeated slices of rx_slice ms.

config SF_RX_MAX_MS
	int "Longest idle listen (ms)"
	range 20 5000
	default 1000
	depends on SF_RX_EVENT_DRIVEN
	help
	  Upper bound on one idle receive operation. Also the worst-case lateness of a
	  timer if a deadline is estimated too late. Must stay below SF_OP_TIMEOUT_MS.

config SF_CANCEL_ON_ACK
	bool "End the ACK wait as soon as an ACK frame is received"
	default y
	select POLL
	help
	  On: while a DATA or PROBE is in flight, the radio thread cancels the
	  RX window when an ACK frame arrives, so the matching ACK is handled
	  at once. Off: the RX window always runs for its full ack_timeout
	  and received frames are handled only when it ends.
	  Any ACK ends the wait early; the node then re-arms the remaining
	  window, so an unrelated ACK costs one extra RX submit, not a lost ACK.

config SF_OP_TIMEOUT_MS
	int "Give up on a modem TX/RX operation after (ms)"
	range 100 10000
	default 6000
	help
	  The modem operation is then cancelled and the run stops.
	  This is a hang guard, not the ACK timer.

config SF_RADIO_STACK
	int "Radio thread stack (bytes)"
	default 8192
	help
	  The radio thread builds a full frame (up to the PHY MTU) on the
	  stack while another copy is waiting for the modem. 8192 covers that
	  plus the log call. Lower it only after a stack report.

config SF_BOOT_LOOP_MAX
	int "Boots inside the guard window before radio start is delayed"
	range 1 20
	default 5

config SF_BOOT_DELAY_CAP_S
	int "Maximum boot-loop radio delay (seconds)"
	range 0 60
	default 60

config SF_BOOT_STABLE_S
	int "Continuous run that clears the boot-loop counter (seconds)"
	range 1 3600
	default 300
	help
	  There is no RTC, so "5 minutes of boots" is approximated by
	  counting boots until the node has been running this long.

config SF_SHELL
	bool "exp shell"
	default y
	select SHELL
	select SHELL_BACKEND_SERIAL
	select REBOOT

config SF_WAIT_FOR_START
	bool "Wait for exp start unless a profile enables autostart"
	default y
	depends on SF_SHELL

config SF_PERSIST
	bool "Save profile and boot epoch in settings/NVS"
	default y
	depends on SF_SHELL
	select SETTINGS
	select NVS
	select FLASH
	select FLASH_MAP
	help
	  exp save stores the profile. The boot epoch is a separate key and
	  is not erased by exp factory. CONFIG_SETTINGS_NVS is a choice
	  symbol; prj.conf sets it.

endmenu

module = SF
module-str = store-and-forward
source "$(ZEPHYR_BASE)/subsys/logging/Kconfig.template.log_config"

menu "Zephyr Kernel"
source "Kconfig.zephyr"
endmenu
```

## prj.conf
```kconfig
CONFIG_NRF_MODEM_LIB=y
CONFIG_MODEM_ANTENNA=n
CONFIG_NRF_MODEM_LINK_BINARY_DECT_PHY=y
CONFIG_HWINFO=y

CONFIG_LOG=y
CONFIG_LOG_MODE_DEFERRED=y
CONFIG_LOG_BUFFER_SIZE=32768
CONFIG_SF_LOG_LEVEL_INF=y

CONFIG_BOOTLOADER_MCUBOOT=y

CONFIG_SF_SHELL=y
CONFIG_SF_WAIT_FOR_START=y
CONFIG_SF_PERSIST=y
CONFIG_SHELL_STACK_SIZE=3072
CONFIG_SHELL_CMD_BUFF_SIZE=256

CONFIG_FLASH=y
CONFIG_FLASH_MAP=y
CONFIG_FLASH_PAGE_LAYOUT=y
CONFIG_MPU_ALLOW_FLASH_WRITE=y
CONFIG_NVS=y
CONFIG_SETTINGS=y
CONFIG_SETTINGS_NVS=y
CONFIG_PM_PARTITION_SIZE_SETTINGS_STORAGE=0x4000
# Experiments reboot every node before each run. The boot-loop guard would delay the
# radio 2 to 60 s after 5 short runs, and shell settings sent in that window are lost.
# 0 disables the delay (the epoch is still advanced at every boot).
CONFIG_SF_BOOT_DELAY_CAP_S=0

# The log thread otherwise wakes only every 1000 ms, so host time stamps lag the board
# clock by up to a second and a second of lines piles up in the buffer.
CONFIG_LOG_PROCESS_THREAD_SLEEP_MS=50

# The main thread runs sf_port_boot (584-byte frame) and then the settings/NVS flash write, whose
# deepest path (sector rotation and garbage collection) needs about 1.1 KB. With the default 1024
# the stack overflowed on the rotation boot and the board stayed silent.
# 2048 is what Nordic's DECT sample uses.
CONFIG_MAIN_STACK_SIZE=2048
```

## fast-uart.overlay
```dts
/*
 * Optional: console, shell and log UART at 460800 baud instead of 115200.
 * Use when the relay drains a backlog faster than the log can be sent.
 * Build with -DEXTRA_DTC_OVERLAY_FILE=fast-uart.overlay and run the logger
 * with --baud 460800. Untested on the Stratus Pro USB-serial bridge.
 */
&uart0 {
	current-speed = <460800>;
};
```

## src/main.c
```c
/*
 * Copyright (c) 2026 Conexio Technologies, Inc
 *
 * SPDX-License-Identifier: Apache-2.0
 *
 * Modem bring-up and the half-duplex radio thread.
 * Protocol decisions live in sf_node.c. This file only moves frames.
 */

#include "sf_phy.h"
#include "sf_port.h"
#include "sf_rxpolicy.h"

#include <string.h>

#include <zephyr/drivers/hwinfo.h>
#include <zephyr/kernel.h>
#include <zephyr/logging/log.h>
#include <zephyr/version.h>
#include <modem/nrf_modem_lib.h>
#include <nrf_modem_at.h>
#include <nrf_modem_dect_phy.h>
#include <ncs_version.h>

LOG_MODULE_DECLARE(app, CONFIG_SF_LOG_LEVEL);

#define TX_HANDLE 0u
#define RX_HANDLE 1u

static bool phy_fatal;
static uint64_t modem_time;
/* Written by the modem callback immediately before it gives op_sem. */
static volatile int op_result;

struct phy_ctrl_field_common {
	uint32_t packet_length : 4;
	uint32_t packet_length_type : 1;
	uint32_t header_format : 3;
	uint32_t short_network_id : 8;
	uint32_t transmitter_id_hi : 8;
	uint32_t transmitter_id_lo : 8;
	uint32_t df_mcs : 3;
	uint32_t reserved : 1;
	uint32_t transmit_power : 4;
	uint32_t pad : 24;
};

K_SEM_DEFINE(op_sem, 0, 4);
/* Given from the modem callback when an ACK frame is decoded (runtime cancel_ack). */
K_SEM_DEFINE(ack_sem, 0, 1);
/* Event-driven idle listening (runtime rx_mode): a frame was queued, and a shell
 * command changed something the radio thread should look at.
 */
K_SEM_DEFINE(frame_sem, 0, 1);
K_SEM_DEFINE(wake_sem, 0, 1);
/* A frame start was seen (PCC) and its end (PDC or an error) was not. The longest frame is
 * 16 subslots, about 3.3 ms, so a start older than RX_FRAME_MAX_MS is treated as over.
 */
#define RX_FRAME_MAX_MS 5
#define RX_GUARD_MS     25
static atomic_t frame_busy;
static volatile int64_t frame_end_ms;

void radio_wake(void)
{
	k_sem_give(&wake_sem);
}

static void sem_give(void)
{
	(void)k_sem_give(&op_sem);
}

static void on_init(const struct nrf_modem_dect_phy_init_event *evt)
{
	if (evt->err) {
		LOG_ERR("phy init %d", evt->err);
		phy_fatal = true;
	}
	sem_give();
}

static void on_deinit(const struct nrf_modem_dect_phy_deinit_event *evt)
{
	ARG_UNUSED(evt);
	sem_give();
}

static void on_activate(const struct nrf_modem_dect_phy_activate_event *evt)
{
	if (evt->err) {
		LOG_ERR("phy activate %d", evt->err);
		phy_fatal = true;
	}
	sem_give();
}

static void on_deactivate(const struct nrf_modem_dect_phy_deactivate_event *evt)
{
	ARG_UNUSED(evt);
	sem_give();
}

static void on_configure(const struct nrf_modem_dect_phy_configure_event *evt)
{
	if (evt->err) {
		LOG_ERR("phy configure %d", evt->err);
		phy_fatal = true;
	}
	sem_give();
}

static bool op_succeeded(int err)
{
	return err == NRF_MODEM_DECT_PHY_SUCCESS || err == NRF_MODEM_DECT_PHY_OK_WITH_HARQ_RESET;
}

static void on_op_complete(const struct nrf_modem_dect_phy_op_complete_event *evt)
{
	op_result = (int)evt->err;
	if (!op_succeeded(op_result)) {
		LOG_WRN("phy op handle %u err %d", evt->handle, op_result);
	}
	sem_give();
}

static void on_cancel(const struct nrf_modem_dect_phy_cancel_event *evt)
{
	/* nrf_modem_dect_phy_cancel() sends this event and also one COMPLETED event for the
	 * cancelled operation. Only COMPLETED gives op_sem, so each operation yields exactly
	 * one token whether or not it was cancelled.
	 */
	ARG_UNUSED(evt);
}

static void on_pdc(const struct nrf_modem_dect_phy_pdc_event *evt)
{
	const uint8_t *data = evt->data;

	sf_port_on_pdc(data, evt->len, (int16_t)evt->rssi_2);
	atomic_clear(&frame_busy);
	/* Signal after the frame is queued so the radio thread finds it on wake-up. */
	k_sem_give(&frame_sem);
	if (sf_port_cancel_ack() && evt->len > 0 && (data[0] & 0x0fu) == SF_TYPE_ACK) {
		k_sem_give(&ack_sem);
	}
}

static void dect_phy_event_handler(const struct nrf_modem_dect_phy_event *evt)
{
	modem_time = evt->time;
	switch (evt->id) {
	case NRF_MODEM_DECT_PHY_EVT_INIT:
		on_init(&evt->init);
		break;
	case NRF_MODEM_DECT_PHY_EVT_DEINIT:
		on_deinit(&evt->deinit);
		break;
	case NRF_MODEM_DECT_PHY_EVT_ACTIVATE:
		on_activate(&evt->activate);
		break;
	case NRF_MODEM_DECT_PHY_EVT_DEACTIVATE:
		on_deactivate(&evt->deactivate);
		break;
	case NRF_MODEM_DECT_PHY_EVT_CONFIGURE:
		on_configure(&evt->configure);
		break;
	case NRF_MODEM_DECT_PHY_EVT_COMPLETED:
		on_op_complete(&evt->op_complete);
		break;
	case NRF_MODEM_DECT_PHY_EVT_CANCELED:
		on_cancel(&evt->cancel);
		break;
	case NRF_MODEM_DECT_PHY_EVT_PDC:
		on_pdc(&evt->pdc);
		break;
	case NRF_MODEM_DECT_PHY_EVT_PDC_ERROR:
	case NRF_MODEM_DECT_PHY_EVT_PCC_ERROR:
		atomic_clear(&frame_busy);
		LOG_DBG("phy crc error t=%" PRIu64, modem_time);
		break;
	case NRF_MODEM_DECT_PHY_EVT_PCC:
		frame_end_ms = k_uptime_get() + RX_FRAME_MAX_MS;
		atomic_set(&frame_busy, 1);
		break;
	case NRF_MODEM_DECT_PHY_EVT_RSSI:
	case NRF_MODEM_DECT_PHY_EVT_RADIO_CONFIG:
	case NRF_MODEM_DECT_PHY_EVT_TIME:
	case NRF_MODEM_DECT_PHY_EVT_CAPABILITY:
	case NRF_MODEM_DECT_PHY_EVT_BANDS:
	case NRF_MODEM_DECT_PHY_EVT_LATENCY:
	case NRF_MODEM_DECT_PHY_EVT_LINK_CONFIG:
	case NRF_MODEM_DECT_PHY_EVT_STF_CONFIG:
	case NRF_MODEM_DECT_PHY_EVT_TEST_RF_TX_CW_CONTROL_CONFIG:
	default:
		break;
	}
}

static int transmit(struct phy_ctrl_field_common *header, const uint8_t *data, uint16_t len,
		   uint8_t power, uint8_t mcs)
{
	struct nrf_modem_dect_phy_tx_params tx;

	memset(header, 0, sizeof(*header));
	header->header_format = 0x0;
	header->packet_length_type = 0x0;
	header->packet_length = sf_phy_len_code(len > 0 ? (data[0] & 0x0fu) : 0, len, sf_port_ctrl_subslots());
	header->short_network_id = (CONFIG_NETWORK_ID & 0xff);
	header->transmitter_id_hi = (uint8_t)(sf_port_node_id() >> 8);
	header->transmitter_id_lo = (uint8_t)(sf_port_node_id() & 0xff);
	header->transmit_power = power;
	header->df_mcs = mcs;

	memset(&tx, 0, sizeof(tx));
	tx.start_time = 0;
	tx.handle = TX_HANDLE;
	tx.network_id = CONFIG_NETWORK_ID;
	tx.phy_type = 0;
	tx.lbt_rssi_threshold_max = 0;
	tx.carrier = CONFIG_CARRIER;
	tx.lbt_period = NRF_MODEM_DECT_LBT_PERIOD_MAX;
	tx.phy_header = (union nrf_modem_dect_phy_hdr *)header;
	tx.data = (uint8_t *)data;
	tx.data_size = len;
	return nrf_modem_dect_phy_tx(&tx);
}

static int receive(uint32_t duration_ms)
{
	struct nrf_modem_dect_phy_rx_params rx = {
		.start_time = 0,
		.handle = RX_HANDLE,
		.network_id = CONFIG_NETWORK_ID,
		.mode = NRF_MODEM_DECT_PHY_RX_MODE_CONTINUOUS,
		.rssi_interval = NRF_MODEM_DECT_PHY_RSSI_INTERVAL_OFF,
		.link_id = NRF_MODEM_DECT_PHY_LINK_UNSPECIFIED,
		.rssi_level = sf_port_rssi_level(),
		.carrier = CONFIG_CARRIER,
		.duration = duration_ms * NRF_MODEM_DECT_MODEM_TIME_TICK_RATE_KHZ,
		.filter.short_network_id = CONFIG_NETWORK_ID & 0xff,
		.filter.is_short_network_id_used = 1,
		.filter.receiver_identity = CONFIG_SF_RX_FILTER_ID,
	};

	return nrf_modem_dect_phy_rx(&rx);
}

static int wait_boot(void)
{
	k_sem_take(&op_sem, K_FOREVER);
	return phy_fatal ? -EIO : 0;
}

static int wait_op(uint32_t handle)
{
	int rc = k_sem_take(&op_sem, K_MSEC(CONFIG_SF_OP_TIMEOUT_MS));
	int result;

	if (rc != 0) {
		LOG_ERR("modem operation %u timed out", handle);
		(void)nrf_modem_dect_phy_cancel(handle);
		(void)k_sem_take(&op_sem, K_MSEC(500));
		while (k_sem_take(&op_sem, K_NO_WAIT) == 0) {
		}
		return -ETIMEDOUT;
	}
	result = op_result;
	while (k_sem_take(&op_sem, K_NO_WAIT) == 0) {
	}
	if (op_succeeded(result)) {
		return 0;
	}
	LOG_WRN("modem operation %u finished err %d", handle, result);
	return -EIO;
}

/*
 * Wait for the RX operation, but end it early when an ACK frame was received.
 * The frame is already in the RX queue (the modem delivers the PDC before we are
 * woken), so cancelling loses nothing; the node re-arms the rest of its window.
 */
static int wait_rx_or_ack(void)
{
	struct k_poll_event ev[2] = {
		K_POLL_EVENT_STATIC_INITIALIZER(K_POLL_TYPE_SEM_AVAILABLE, K_POLL_MODE_NOTIFY_ONLY,
						&op_sem, 0),
		K_POLL_EVENT_STATIC_INITIALIZER(K_POLL_TYPE_SEM_AVAILABLE, K_POLL_MODE_NOTIFY_ONLY,
						&ack_sem, 0),
	};
	int rc = k_poll(ev, 2, K_MSEC(CONFIG_SF_OP_TIMEOUT_MS));

	if (rc != 0 || ev[0].state == K_POLL_STATE_SEM_AVAILABLE) {
		return wait_op(RX_HANDLE);
	}
	(void)k_sem_take(&ack_sem, K_NO_WAIT);
	(void)nrf_modem_dect_phy_cancel(RX_HANDLE);
	/* The cancelled RX operation reports COMPLETED once; its result is not needed. */
	if (k_sem_take(&op_sem, K_MSEC(500)) != 0) {
		LOG_ERR("rx cancel timed out");
		return -ETIMEDOUT;
	}
	return 0;
}

/*
 * Idle listen (see sf_rxpolicy.h): one long
 * receive that this thread ends. The decision is sf_rx_decide() (host-tested). Returns 0 once
 * the receive operation is over; the caller then drains the frame queue.
 */
static int rx_idle_wait(uint32_t listen_ms)
{
	int64_t end = k_uptime_get() + (int64_t)listen_ms;
	struct k_poll_event ev[3];
	struct sf_rx_state st = {.ack_wait = false, .frame_in_progress = false};

	while (true) {
		int64_t left = end - k_uptime_get();
		enum sf_rx_event e;
		int rc;

		k_poll_event_init(&ev[0], K_POLL_TYPE_SEM_AVAILABLE, K_POLL_MODE_NOTIFY_ONLY, &op_sem);
		k_poll_event_init(&ev[1], K_POLL_TYPE_SEM_AVAILABLE, K_POLL_MODE_NOTIFY_ONLY, &frame_sem);
		k_poll_event_init(&ev[2], K_POLL_TYPE_SEM_AVAILABLE, K_POLL_MODE_NOTIFY_ONLY, &wake_sem);
		rc = k_poll(ev, 3, K_MSEC(left > 0 ? left : 0));
		if (rc == 0 && ev[0].state == K_POLL_STATE_SEM_AVAILABLE) {
			return wait_op(RX_HANDLE); /* the receive ended by itself */
		}
		if (rc != 0) {
			e = SF_RXE_DEADLINE;
		} else if (ev[1].state == K_POLL_STATE_SEM_AVAILABLE) {
			(void)k_sem_take(&frame_sem, K_NO_WAIT);
			e = SF_RXE_FRAME;
		} else {
			(void)k_sem_take(&wake_sem, K_NO_WAIT);
			e = SF_RXE_WAKE;
		}
		st.frame_in_progress = atomic_get(&frame_busy) != 0 && k_uptime_get() < frame_end_ms;
		switch (sf_rx_decide(&st, e)) {
		case SF_RXA_CONTINUE:
			continue;
		case SF_RXA_WAIT_FRAME_END: {
			int64_t wait = frame_end_ms - k_uptime_get();

			if (wait > 0) {
				(void)k_sem_take(&frame_sem, K_MSEC(wait));
			}
			break;
		}
		case SF_RXA_CANCEL_NOW:
		default:
			break;
		}
		break;
	}
	(void)nrf_modem_dect_phy_cancel(RX_HANDLE);
	/* The cancelled receive reports COMPLETED once (as in wait_rx_or_ack). */
	if (k_sem_take(&op_sem, K_MSEC(500)) != 0) {
		LOG_ERR("rx cancel timed out");
		return -ETIMEDOUT;
	}
	return 0;
}

static void drain_sem(void)
{
	while (k_sem_take(&op_sem, K_NO_WAIT) == 0) {
	}
}

static void radio_thread(void *p1, void *p2, void *p3)
{
	ARG_UNUSED(p1);
	ARG_UNUSED(p2);
	ARG_UNUSED(p3);

	while (1) {
		sf_port_wait_until_started();
		while (sf_port_running()) {
			struct sf_action act;
			struct phy_ctrl_field_common header;
			uint8_t buf[CONFIG_SF_PHY_MTU];
			uint8_t power;
			uint8_t mcs;
			int err;

			sf_port_note_stable_if_due();
			sf_port_poll(&act);
			if (!sf_port_running()) {
				break;
			}
			if (act.kind == SF_ACT_TX) {
				if (act.tx_len == 0 || act.tx_len > sizeof(buf)) {
					sf_port_on_tx_done(false, act.inflight);
					continue;
				}
				memcpy(buf, act.tx, act.tx_len);
				sf_port_radio(&power, &mcs);
				drain_sem();
				err = transmit(&header, buf, act.tx_len, power, mcs);
				if (err != 0) {
					LOG_ERR("tx submit %d", err);
					sf_port_on_tx_done(false, act.inflight);
					continue;
				}
				err = wait_op(TX_HANDLE);
				if (err == -ETIMEDOUT) {
					sf_port_stop("modem_timeout");
					break;
				}
				/* LBT busy, bad header, or a rejected op: the frame did not
				 * leave the radio. Count the attempt and keep listening.
				 */
				sf_port_on_tx_done(err == 0, act.inflight);
			} else {
				uint32_t slice = act.rx_ms == 0 ? 1u : act.rx_ms;

				bool idle = act.idle_listen;

				drain_sem();
				k_sem_reset(&ack_sem);
				k_sem_reset(&frame_sem);
				/* An idle listen is ended by this thread, so the operation is made
				 * a little longer than the listen and never expires first.
				 */
				err = receive(idle ? slice + RX_GUARD_MS : slice);
				if (err != 0) {
					LOG_ERR("rx submit %d", err);
					sf_port_stop("rx_error");
					break;
				}
				if (idle) {
					err = rx_idle_wait(slice);
				} else if (sf_port_cancel_ack() && act.ack_wait) {
					err = wait_rx_or_ack();
				} else {
					err = wait_op(RX_HANDLE);
				}
				if (err == -ETIMEDOUT) {
					sf_port_stop("modem_timeout");
					break;
				}
				if (err != 0) {
					LOG_ERR("rx operation failed");
					sf_port_stop("rx_error");
					break;
				}
				sf_port_drain_rx();
			}
		}
	}
}

static K_THREAD_STACK_DEFINE(radio_stack, CONFIG_SF_RADIO_STACK);
static struct k_thread radio_thread_data;

static uint16_t read_device_id(void)
{
	uint16_t id = 0;

#if IS_ENABLED(CONFIG_SF_DEVICE_ID_OVERRIDE)
	id = (uint16_t)CONFIG_SF_DEVICE_ID;
#else
	if (hwinfo_get_device_id((uint8_t *)&id, sizeof(id)) < 0) {
		/* Every board would end up with the same id 1. */
		LOG_ERR("device id unavailable: set CONFIG_SF_DEVICE_ID_OVERRIDE");
		id = 0;
	}
#endif
	return id;
}

static int boot_phy(void)
{
	static const struct nrf_modem_dect_phy_config_params params = {
		.band_group_index = ((CONFIG_CARRIER >= 525 && CONFIG_CARRIER <= 551)) ? 1 : 0,
		.harq_rx_process_count = CONFIG_SF_HARQ_RX_PROCESSES,
		.harq_rx_expiry_time_us = CONFIG_SF_HARQ_RX_EXPIRY_US,
	};
	int err;

	err = nrf_modem_lib_init();
	if (err != 0) {
		LOG_ERR("modem lib %d", err);
		return err;
	}
	err = nrf_modem_dect_phy_event_handler_set(dect_phy_event_handler);
	if (err != 0) {
		LOG_ERR("phy handler %d", err);
		return err;
	}
	err = nrf_modem_dect_phy_init();
	if (err != 0 || wait_boot() != 0) {
		LOG_ERR("phy init failed");
		return err != 0 ? err : -EIO;
	}
	err = nrf_modem_dect_phy_configure(&params);
	if (err != 0 || wait_boot() != 0) {
		LOG_ERR("phy configure failed");
		return err != 0 ? err : -EIO;
	}
	err = nrf_modem_dect_phy_activate(NRF_MODEM_DECT_PHY_RADIO_MODE_LOW_LATENCY);
	if (err != 0 || wait_boot() != 0) {
		LOG_ERR("phy activate failed");
		return err != 0 ? err : -EIO;
	}
	return 0;
}

/*
 * One line of firmware identity and one of modem identity, so every raw log says what it ran on.
 * The AT queries are read-only. Static buffers keep them off the main stack.
 */
static void log_boot_info(void)
{
	static char fw[64];
	static char hw[64];
	static char uuid[48];
	int temp_c = 0;
	int vbat_mv = 0;

	LOG_INF("BOOT_INFO: fw=%s ncs=%s zephyr=%s main_stack=%d radio_stack=%d carrier=%d net=%d",
		SF_GIT_REV, NCS_VERSION_STRING, KERNEL_VERSION_STRING, CONFIG_MAIN_STACK_SIZE,
		CONFIG_SF_RADIO_STACK, CONFIG_CARRIER, CONFIG_NETWORK_ID);
	if (nrf_modem_at_scanf("AT+CGMR", "%63[^\r\n]", fw) <= 0) {
		strcpy(fw, "unknown");
	}
	if (nrf_modem_at_scanf("AT%HWVERSION", "%%HWVERSION: %63[^\r\n]", hw) <= 0) {
		strcpy(hw, "unknown");
	}
	if (nrf_modem_at_scanf("AT%XMODEMUUID", "%%XMODEMUUID: %47[^\r\n]", uuid) <= 0) {
		strcpy(uuid, "unknown");
	}
	if (nrf_modem_at_scanf("AT%XTEMP?", "%%XTEMP: %d", &temp_c) <= 0) {
		temp_c = -999;
	}
	if (nrf_modem_at_scanf("AT%XVBAT", "%%XVBAT: %d", &vbat_mv) <= 0) {
		vbat_mv = -1;
	}
	LOG_INF("BOOT_MODEM: fw=%s hw=%s uuid=%s temp_c=%d vbat_mv=%d", fw, hw, uuid, temp_c, vbat_mv);
}

int main(void)
{
	int err;

	sf_port_boot(read_device_id());
	err = boot_phy();
	if (err != 0) {
		return err;
	}
	log_boot_info();
	k_thread_create(&radio_thread_data, radio_stack, CONFIG_SF_RADIO_STACK, radio_thread, NULL,
			NULL, NULL, 5, 0, K_NO_WAIT);
	k_thread_name_set(&radio_thread_data, "sf_radio");
	LOG_INF("shell: exp status|sett|route|start|stop|sf|link|neigh|alarm|save|load");
	if (sf_port_autostart_ok()) {
		err = sf_port_start(0);
		if (err != 0) {
			LOG_WRN("autostart failed %d", err);
		}
	} else {
		LOG_INF("idle — exp start");
	}
	return 0;
}
```

## src/sf_link.c
```c
/*
 * Copyright (c) 2026 Conexio Technologies, Inc
 *
 * SPDX-License-Identifier: Apache-2.0
 */

#include "sf_link.h"

void sf_link_init(struct sf_link_table *t)
{
	unsigned int i;

	for (i = 0; i < SF_LINK_CAP; i++) {
		t->item[i].used = false;
	}
}

struct sf_link *sf_link_find(struct sf_link_table *t, uint16_t next_id)
{
	unsigned int i;

	for (i = 0; i < SF_LINK_CAP; i++) {
		if (t->item[i].used && t->item[i].next_id == next_id) {
			return &t->item[i];
		}
	}
	return NULL;
}

struct sf_link *sf_link_ensure(struct sf_link_table *t, uint16_t next_id, int64_t now,
			       bool assume_up)
{
	struct sf_link *l = sf_link_find(t, next_id);
	unsigned int i;

	if (next_id == 0 || next_id == SF_ID_BCAST) {
		return NULL;
	}
	if (l != NULL) {
		return l;
	}
	for (i = 0; i < SF_LINK_CAP; i++) {
		if (!t->item[i].used) {
			l = &t->item[i];
			break;
		}
	}
	if (l == NULL) {
		return NULL;
	}
	l->used = true;
	l->next_id = next_id;
	l->state = assume_up ? SF_LINK_UP : SF_LINK_DOWN;
	l->consec = 0;
	l->down_streak = 0;
	l->heard = false;
	l->last_heard_ms = 0;
	l->returned = false;
	l->hold_until_ms = now;
	l->up_since_ms = now;
	l->next_probe_ms = now;
	return l;
}

static uint32_t hold_ms(uint8_t streak, uint32_t min_ms, uint32_t max_ms)
{
	uint32_t h = min_ms;
	uint8_t i;

	if (streak < 1) {
		streak = 1;
	}
	for (i = 1; i < streak; i++) {
		if (max_ms > 0 && h > max_ms / 2u) {
			return max_ms;
		}
		h *= 2u;
	}
	if (max_ms > 0 && h > max_ms) {
		return max_ms;
	}
	return h;
}

static void change(struct sf_link *l, uint8_t next, const char *reason, sf_link_fn fn, void *ctx)
{
	uint8_t old = l->state;

	l->state = next;
	if (fn != NULL && old != next) {
		fn(ctx, l, old, reason);
	}
}

void sf_link_fail(struct sf_link *l, int64_t now, const char *reason, uint32_t hold_min_ms,
		  uint32_t hold_max_ms, uint32_t hold_reset_ms, uint32_t t_probe_ms,
		  sf_link_fn on_change, void *ctx)
{
	uint8_t streak;

	if (l == NULL) {
		return;
	}
	if (l->state == SF_LINK_UP && hold_reset_ms > 0 &&
	    (now - l->up_since_ms) >= (int64_t)hold_reset_ms) {
		streak = 1;
	} else {
		streak = (uint8_t)(l->down_streak + 1u);
		if (streak == 0) {
			streak = 255;
		}
	}
	l->down_streak = streak;
	l->consec = 0;
	l->heard = false;
	l->returned = false;
	l->hold_until_ms = now + (int64_t)hold_ms(streak, hold_min_ms, hold_max_ms);
	l->next_probe_ms = l->hold_until_ms + (int64_t)t_probe_ms;
	change(l, SF_LINK_DOWN, reason, on_change, ctx);
}

void sf_link_tick(struct sf_link_table *t, int64_t now, uint32_t hello_dead_ms, uint32_t t_probe_ms,
		  uint32_t hold_min_ms, uint32_t hold_max_ms, uint32_t hold_reset_ms,
		  sf_link_fn on_change, void *ctx)
{
	unsigned int i;

	for (i = 0; i < SF_LINK_CAP; i++) {
		struct sf_link *l = &t->item[i];

		if (!l->used) {
			continue;
		}
		if (l->state == SF_LINK_UP && hello_dead_ms > 0 && l->heard &&
		    (now - l->last_heard_ms) > (int64_t)hello_dead_ms) {
			l->heard = false;
			sf_link_fail(l, now, "hello_dead", hold_min_ms, hold_max_ms, hold_reset_ms,
				     t_probe_ms, on_change, ctx);
			continue;
		}
		if (l->state == SF_LINK_DOWN && l->returned) {
			/* A neighbour that was silent is audible again: probe now, the hold-down was
			 * meant for a link that keeps failing, not for one that was simply gone.
			 */
			l->returned = false;
			l->consec = 0;
			l->next_probe_ms = now;
			change(l, SF_LINK_PROBING, "returned", on_change, ctx);
			continue;
		}
		if (l->state == SF_LINK_DOWN && now >= l->hold_until_ms) {
			bool timer = (t_probe_ms == 0) || (now >= l->next_probe_ms);

			if (l->heard || timer) {
				l->consec = 0;
				l->next_probe_ms = now;
				change(l, SF_LINK_PROBING, l->heard ? "hello" : "t_probe",
				       on_change, ctx);
			}
		}
	}
}

void sf_link_note_heard(struct sf_link *l, int64_t now, uint32_t silence_ms)
{
	if (l == NULL) {
		return;
	}
	if (silence_ms > 0 && l->state == SF_LINK_DOWN && l->last_heard_ms != 0 &&
	    (now - l->last_heard_ms) >= (int64_t)silence_ms) {
		l->returned = true;
	}
	l->heard = true;
	l->last_heard_ms = now;
}

void sf_link_probe_ok(struct sf_link *l, int64_t now, uint8_t n_up, uint32_t probe_fast_ms,
		      sf_link_fn on_change, void *ctx)
{
	if (l == NULL) {
		return;
	}
	if (n_up == 0) {
		n_up = 1;
	}
	l->consec++;
	l->next_probe_ms = now + (int64_t)probe_fast_ms;
	if (l->state == SF_LINK_PROBING && l->consec >= n_up) {
		l->up_since_ms = now;
		change(l, SF_LINK_UP, "probes", on_change, ctx);
	}
}

void sf_link_force_probe(struct sf_link *l, int64_t now, sf_link_fn on_change, void *ctx)
{
	if (l == NULL) {
		return;
	}
	l->consec = 0;
	l->hold_until_ms = now;
	l->next_probe_ms = now;
	l->heard = true;
	l->last_heard_ms = now;
	if (l->state != SF_LINK_PROBING) {
		change(l, SF_LINK_PROBING, "neighbor_reset", on_change, ctx);
	}
}
```

## src/sf_link.h
```c
/*
 * Copyright (c) 2026 Conexio Technologies, Inc
 *
 * SPDX-License-Identifier: Apache-2.0
 */

#ifndef SF_LINK_H_
#define SF_LINK_H_

#include "sf_types.h"

struct sf_link {
	bool used;
	uint16_t next_id;
	uint8_t state;
	uint8_t consec;
	uint8_t down_streak;
	bool heard; /* a frame (any type, with CONFIG_SF_LIVENESS_ANY_FRAME) was heard from next_id */
	int64_t last_heard_ms;
	bool returned; /* silent neighbour came back: leave DOWN without waiting for the hold-down */
	int64_t hold_until_ms;
	int64_t up_since_ms;
	int64_t next_probe_ms;
};

struct sf_link_table {
	struct sf_link item[SF_LINK_CAP];
};

typedef void (*sf_link_fn)(void *ctx, const struct sf_link *link, uint8_t old_state,
			   const char *reason);

void sf_link_init(struct sf_link_table *t);
struct sf_link *sf_link_find(struct sf_link_table *t, uint16_t next_id);
struct sf_link *sf_link_ensure(struct sf_link_table *t, uint16_t next_id, int64_t now,
			       bool assume_up);
void sf_link_tick(struct sf_link_table *t, int64_t now, uint32_t hello_dead_ms, uint32_t t_probe_ms,
		  uint32_t hold_min_ms, uint32_t hold_max_ms, uint32_t hold_reset_ms,
		  sf_link_fn on_change, void *ctx);
/* silence_ms > 0: a frame after at least that much silence from a DOWN link's neighbour marks it returned. */
void sf_link_note_heard(struct sf_link *l, int64_t now, uint32_t silence_ms);
void sf_link_probe_ok(struct sf_link *l, int64_t now, uint8_t n_up, uint32_t probe_fast_ms,
		      sf_link_fn on_change, void *ctx);
void sf_link_fail(struct sf_link *l, int64_t now, const char *reason, uint32_t hold_min_ms,
		  uint32_t hold_max_ms, uint32_t hold_reset_ms, uint32_t t_probe_ms,
		  sf_link_fn on_change, void *ctx);
void sf_link_force_probe(struct sf_link *l, int64_t now, sf_link_fn on_change, void *ctx);

#endif /* SF_LINK_H_ */
```

## src/sf_node.h
```c
/*
 * Copyright (c) 2026 Conexio Technologies, Inc
 *
 * SPDX-License-Identifier: Apache-2.0
 *
 * Protocol engine. No Zephyr calls: the radio thread and the host test both
 * drive poll / on_tx_done / on_rx. One DATA or PROBE frame is in flight.
 */

#ifndef SF_NODE_H_
#define SF_NODE_H_

#include "sf_link.h"
#include "sf_store.h"
#include "sf_dedup.h"

#include <stddef.h>

enum sf_act_kind {
	SF_ACT_RX = 0,
	SF_ACT_TX = 1,
};

struct sf_action {
	uint8_t kind;
	bool inflight; /* TX is the tracked DATA/PROBE, not an ACK or HELLO */
	bool want_ack;
	bool ack_wait; /* RX window is waiting for the ACK of the in-flight frame */
	bool idle_listen; /* RX until the next deadline, ended early by a frame (event-driven) */
	uint32_t rx_ms;
	uint16_t tx_len;
	uint8_t tx[SF_PAYLOAD_MAX];
};

typedef void (*sf_emit_fn)(void *ctx, const char *line);
typedef void (*sf_print_fn)(void *ctx, const char *line);
typedef uint32_t (*sf_rng_fn)(void);
typedef int64_t (*sf_us_fn)(void);

struct sf_node;

void sf_node_init(struct sf_node *n, const struct sf_cfg *cfg, const struct sf_route *routes,
		  unsigned int nroutes, uint16_t epoch, struct sf_store store);
void sf_node_set_emit(struct sf_node *n, sf_emit_fn fn, void *ctx);
void sf_node_set_rng(struct sf_node *n, sf_rng_fn fn);
void sf_node_set_clock(struct sf_node *n, sf_us_fn fn);

int sf_node_start(struct sf_node *n, int64_t now, uint32_t count_or_zero_for_cfg);
void sf_node_stop(struct sf_node *n, int64_t now, const char *reason);
bool sf_node_running(const struct sf_node *n);
uint16_t sf_node_epoch(const struct sf_node *n);
const struct sf_cfg *sf_node_cfg(const struct sf_node *n);
const struct sf_counters *sf_node_counters(const struct sf_node *n);
const struct sf_store *sf_node_store(const struct sf_node *n);

void sf_node_poll(struct sf_node *n, int64_t now, struct sf_action *act);
void sf_node_on_tx_done(struct sf_node *n, int64_t now, bool ok, bool was_inflight);
void sf_node_on_rx(struct sf_node *n, int64_t now, const uint8_t *data, uint16_t len,
		   int16_t rssi_x2);

int sf_node_alarm(struct sf_node *n, int64_t now);
uint16_t sf_node_flush(struct sf_node *n, int64_t now, const char *reason);

int sf_node_set(struct sf_node *n, const char *key, const char *value, char *err, size_t err_len);
int sf_node_route_set(struct sf_node *n, uint16_t dst, uint16_t next, char *err, size_t err_len);
int sf_node_route_del(struct sf_node *n, uint16_t dst);
void sf_node_route_clear(struct sf_node *n);
void sf_node_apply_cfg(struct sf_node *n, const struct sf_cfg *cfg);

void sf_node_dump_cfg(const struct sf_node *n, sf_print_fn fn, void *ctx);
void sf_node_status(const struct sf_node *n, int64_t now, sf_print_fn fn, void *ctx);
void sf_node_report_sf(const struct sf_node *n, sf_print_fn fn, void *ctx);
void sf_node_report_link(const struct sf_node *n, sf_print_fn fn, void *ctx);
void sf_node_report_neigh(const struct sf_node *n, sf_print_fn fn, void *ctx);
void sf_node_report_route(const struct sf_node *n, sf_print_fn fn, void *ctx);

unsigned int sf_node_route_export(const struct sf_node *n, struct sf_route *out, unsigned int cap);

/* Opaque size: the test and the port allocate sf_node by this header's struct.
 * The full struct is in the header so the firmware can put it in BSS.
 */
struct sf_ack_slot {
	uint16_t len;
	uint8_t buf[32];
};

struct sf_inflight {
	bool active;
	bool from_store;
	bool waiting_backoff;
	uint8_t type;
	uint8_t attempts;
	uint8_t class_;
	uint16_t next_id;
	uint16_t src;
	uint16_t seq;
	uint16_t epoch;
	uint32_t order;
	int64_t deadline_ms;
	int64_t backoff_until_ms;
	int64_t tx_done_ms;
	int64_t tx_done_us;
	uint16_t len;
	uint8_t buf[SF_PAYLOAD_MAX];
};

struct sf_neigh {
	bool used;
	bool have_epoch;
	uint16_t id;
	uint16_t epoch;
	int16_t rssi_x2;
	int64_t last_ms;
	uint32_t heard;
};

struct sf_node {
	struct sf_cfg cfg;
	struct sf_store store;
	struct sf_dedup dedup;
	struct sf_link_table links;
	struct sf_route route[SF_ROUTE_CAP];
	struct sf_neigh neigh[SF_NEIGH_CAP];
	struct sf_counters ct;
	struct sf_inflight inf;
	struct sf_ack_slot ackq[SF_ACKQ_CAP];
	uint8_t ack_n;
	uint32_t ack_dropped;
	uint16_t seq_next[2];
	uint16_t epoch;
	uint32_t probe_nonce;
	uint32_t run_count;
	uint32_t alarm_tokens_m;
	int64_t alarm_ts_ms;
	int64_t last_gen_ms;
	int64_t next_hello_ms;
	int64_t gap_until_ms;
	int64_t holdoff_ms[2];
	bool running;
	char line[240];
	sf_emit_fn emit;
	void *emit_ctx;
	sf_rng_fn rng;
	sf_us_fn clock_us;
};

#endif /* SF_NODE_H_ */
```

## src/sf_phy.h
```c
/*
 * Copyright (c) 2026 Conexio Technologies, Inc
 *
 * SPDX-License-Identifier: Apache-2.0
 *
 * Type-1 PHY header packet_length code for a frame. No Zephyr and no modem:
 * compiled by the image and by the host test.
 */

#ifndef SF_PHY_H_
#define SF_PHY_H_

#include "sf_types.h"

#include <stdint.h>

/*
 * DATA uses this rule (up to 32 bytes: 0x03, up to 64: 0x07, else 0x0F).
 * HELLO, ACK and PROBE use at least the length chosen by ctrl_subslots (4, 8 or 16 subslots
 * = 0x03, 0x07, 0x0F), never less than the rule above, so ctrl_subslots 4 gives the 4-subslot code for control frames.
 */
static inline uint8_t sf_phy_len_code(uint8_t frame_type, uint16_t len, uint8_t ctrl_subslots)
{
	uint8_t code = len <= 32 ? 0x03 : (len <= 64 ? 0x07 : 0x0F);
	uint8_t ctrl = ctrl_subslots >= 16 ? 0x0F : (ctrl_subslots >= 8 ? 0x07 : 0x03);

	if (frame_type != SF_TYPE_DATA && ctrl > code) {
		code = ctrl;
	}
	return code;
}

#endif /* SF_PHY_H_ */
```

## src/sf_port.h
```c
/*
 * Copyright (c) 2026 Conexio Technologies, Inc
 *
 * SPDX-License-Identifier: Apache-2.0
 */

#ifndef SF_PORT_H_
#define SF_PORT_H_

#include "sf_node.h"

#include <stdbool.h>
#include <stdint.h>

void sf_port_boot(uint16_t node_id);
uint16_t sf_port_node_id(void);
bool sf_port_autostart_ok(void);

int sf_port_start(uint32_t count_or_zero);
void sf_port_stop(const char *reason);
void sf_port_reboot(void);
/* Defined in main.c: make an idle listen return so the radio thread looks at the node. */
void radio_wake(void);
bool sf_port_running(void);
void sf_port_wait_until_started(void);

void sf_port_poll(struct sf_action *act);
void sf_port_on_tx_done(bool ok, bool was_inflight);
void sf_port_on_pdc(const uint8_t *data, uint16_t len, int16_t rssi_x2);
void sf_port_drain_rx(void);
void sf_port_radio(uint8_t *power, uint8_t *mcs);
/* Runtime settings read by the modem callback and radio thread (no lock). */
bool sf_port_cancel_ack(void);
uint8_t sf_port_ctrl_subslots(void);
int8_t sf_port_rssi_level(void);
void sf_port_note_stable_if_due(void);

int sf_port_set(const char *key, const char *value, char *err, size_t err_len);
int sf_port_route_set(uint16_t dst, uint16_t next, char *err, size_t err_len);
int sf_port_route_del(uint16_t dst);
int sf_port_alarm(void);
uint16_t sf_port_flush(const char *reason);
int sf_port_save(void);
int sf_port_load(char *err, size_t err_len);
int sf_port_factory(char *err, size_t err_len);
void sf_port_autostart_set(bool on);
bool sf_port_autostart_get(void);
bool sf_port_profile_present(void);

void sf_port_print_status(sf_print_fn fn, void *ctx);
void sf_port_print_cfg(sf_print_fn fn, void *ctx);
void sf_port_print_sf(sf_print_fn fn, void *ctx);
void sf_port_print_link(sf_print_fn fn, void *ctx);
void sf_port_print_neigh(sf_print_fn fn, void *ctx);
void sf_port_print_route(sf_print_fn fn, void *ctx);

#endif /* SF_PORT_H_ */
```

## src/sf_rxpolicy.h
```c
/*
 * Copyright (c) 2026 Conexio Technologies, Inc
 *
 * SPDX-License-Identifier: Apache-2.0
 *
 * Pure decision for the idle receive. No Zephyr and no modem: compiled by the image and by the host test.
 */

#ifndef SF_RXPOLICY_H_
#define SF_RXPOLICY_H_

#include <stdbool.h>
#include <stdint.h>

enum sf_rx_event {
	SF_RXE_FRAME,    /* a frame was received and queued */
	SF_RXE_ACK,      /* an ACK frame was received and queued */
	SF_RXE_WAKE,     /* a shell command changed something (start, stop, setting) */
	SF_RXE_DEADLINE, /* the node's next deadline is reached */
};

enum sf_rx_action {
	SF_RXA_CONTINUE,       /* keep listening, ignore the event */
	SF_RXA_CANCEL_NOW,     /* cancel the receive and let the node act */
	SF_RXA_WAIT_FRAME_END, /* a frame is arriving: wait for its end, then cancel */
};

struct sf_rx_state {
	bool ack_wait;           /* a DATA or PROBE of ours waits for its ACK */
	bool frame_in_progress;  /* a frame start was seen, its end not yet */
};

static inline enum sf_rx_action sf_rx_decide(const struct sf_rx_state *s, enum sf_rx_event e)
{
	switch (e) {
	case SF_RXE_ACK:
		/* the one event allowed to end an ACK wait. */
		return SF_RXA_CANCEL_NOW;
	case SF_RXE_FRAME:
		/* during an ACK wait other frames stay queued until the wait ends.
		 * when idle, a complete frame is handed to the node at once.
		 */
		return s->ack_wait ? SF_RXA_CONTINUE : SF_RXA_CANCEL_NOW;
	case SF_RXE_WAKE:
	case SF_RXE_DEADLINE:
	default:
		/* never cut a frame that is arriving. */
		return s->frame_in_progress ? SF_RXA_WAIT_FRAME_END : SF_RXA_CANCEL_NOW;
	}
}

#endif /* SF_RXPOLICY_H_ */
```
